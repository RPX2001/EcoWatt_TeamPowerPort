## PIO/ECOWATT/sdkconfig.defaults
```kconfig
#
# ESP32 Task Watchdog Timer Configuration - COMPLETELY DISABLED
#
CONFIG_ESP_TASK_WDT=n
CONFIG_ESP_TASK_WDT_PANIC=n
CONFIG_ESP_TASK_WDT_TIMEOUT_S=300
CONFIG_ESP_TASK_WDT_CHECK_IDLE_TASK_CPU0=n
CONFIG_ESP_TASK_WDT_CHECK_IDLE_TASK_CPU1=n

#
# Interrupt Watchdog - DISABLED
#
CONFIG_ESP_INT_WDT=n
CONFIG_ESP_INT_WDT_TIMEOUT_MS=300
CONFIG_ESP_INT_WDT_CHECK_CPU0=n
CONFIG_ESP_INT_WDT_CHECK_CPU1=n

#
# FreeRTOS - Increase tick rate for better responsiveness
#
CONFIG_FREERTOS_HZ=1000
```
